#include "ui/framebuffer.h"

#include <string.h>
#include "app_config.h"

static uint8_t fb[OLED_PAGES][OLED_W];

/* ASCII 32..90 */
static const uint8_t font6x8[][6] = {
    {0,0,0,0,0,0},{0,0,0x5F,0,0,0},{0,7,0,7,0,0},{0x14,0x7F,0x14,0x7F,0x14,0},
    {0x24,0x2A,0x7F,0x2A,0x12,0},{0x23,0x13,8,0x64,0x62,0},{0x36,0x49,0x55,0x22,0x50,0},
    {0,5,3,0,0,0},{0,0x1C,0x22,0x41,0,0},{0,0x41,0x22,0x1C,0,0},{0x14,8,0x3E,8,0x14,0},
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    {3,4,0x78,4,3,0},{0x61,0x51,0x49,0x45,0x43,0},
};

void fb_clear(void) { memset(fb, 0, sizeof(fb)); }

static void fb_draw_char(uint8_t x, uint8_t page, char c) {
    if (page >= OLED_PAGES) return;
    if (x > (OLED_W - 6)) return;
    if (c < 32 || c > 90) c = ' ';
    const uint8_t *gph = font6x8[(uint8_t)(c - 32)];
    for (int i = 0; i < 6; i++) fb[page][x + i] = gph[i];
}

void fb_draw_text(uint8_t x, uint8_t page, const char *s) {
    uint8_t cx = x;
    while (*s && cx <= (OLED_W - 6)) {
        fb_draw_char(cx, page, *s++);
        cx = (uint8_t)(cx + 6);
    }
}

const uint8_t *fb_pages_flattened(void) {
    return (const uint8_t *)&fb[0][0];
}

int fb_pages_count(void) { return OLED_PAGES; }
int fb_width(void) { return OLED_W; }